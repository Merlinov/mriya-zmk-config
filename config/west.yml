## config/west.yml
```yaml
manifest:
  remotes:
    - name: zmkfirmware
      url-base: https://github.com/zmkfirmware
    - name: Merlinov
      url-base: https://github.com/Merlinov
      - name: gpeye                         #new entry
      url-base: https://github.com/GPeye  #new entry
  
  projects:
    - name: zmk
      remote: Merlinov
      revision: main
      import: app/west.yml
      - name: nice-view-mod                 #new entry
      remote: gpeye                       #new entry
      revision: main                      #new entry
  self:
    path: config
```
